VERSION ""

NS_ :

BS_:

BU_:

BO_ 1 New_Message_2: 8 Vector__XXX
 SG_ New_Signal_3 : 24|33@0- (1,0) [0|0] "" Vector__XXX
 SG_ intelTest : 5|24@1- (1,0) [0|0] "" Vector__XXX

BO_ 0 New_Message_3: 8 Vector__XXX
 SG_ motorola : 39|32@0- (1,0) [0|0] "" Vector__XXX
 SG_ intelTest : 0|24@1- (1,0) [0|0] "" Vector__XXX
